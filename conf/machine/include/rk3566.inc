## conf/machine/include/rk3566.inc
```bitbake
# ???????? what is the relation between rk3566 and rk3568
require conf/machine/include/rk356x.inc

MACHINEOVERRIDES =. "rk3566:"
KERNEL_FEATURES:append:rk3566 = " bsp/rockchip/remove-non-rockchip-arch-arm64.scc"
```

## conf/machine/include/rk3568.inc
```bitbake
# ???????? what is the relation between rk3566 and rk3568
require conf/machine/include/rk356x.inc

MACHINEOVERRIDES =. "rk3568:"
KERNEL_FEATURES:append:rk3568 = " bsp/rockchip/remove-non-rockchip-arch-arm64.scc"
```

## conf/machine/include/rock-pi-4.inc
```bitbake
# Add a common override for all Rock Pi 4 machines
MACHINEOVERRIDES =. "rock-pi-4:"

require conf/machine/include/rk3399.inc

MACHINE_ESSENTIAL_EXTRA_RRECOMMENDS += "kernel-modules"
```

## conf/machine/radxa-cm3-io.conf
```bitbake
#@TYPE: Machine
#@NAME: Radxa CM3 IO
#@DESCRIPTION: ROCK3 is the 3th generation of SBC and Computer Module designed by Radxa.
#https://wiki.radxa.com/Rock3/CM3/IO

require conf/machine/include/rk3566.inc

PREFERRED_PROVIDER_virtual/kernel = "linux-yocto-dev"
KERNEL_DEVICETREE = "rockchip/rk3566-radxa-cm3-io.dtb"
MACHINE_EXTRA_RRECOMMENDS += "kernel-modules"

UBOOT_MACHINE = "radxa-cm3-io-rk3566_defconfig"
```

## conf/machine/radxa-e25.conf
```bitbake
#@TYPE: Machine
#@NAME: Radxa E25
#@DESCRIPTION: ROCK3 is the 3th generation of SBC and Computer Module designed by Radxa.
#https://wiki.radxa.com/Rock3/CM3/IO

require conf/machine/include/rk3568.inc

PREFERRED_PROVIDER_virtual/kernel = "linux-yocto-dev"
KERNEL_DEVICETREE = "rockchip/rk3568-radxa-e25.dtb"
MACHINE_EXTRA_RRECOMMENDS += "kernel-modules"

UBOOT_MACHINE = "radxa-e25-rk3568_defconfig"
```

## conf/machine/rock-3a.conf
```bitbake
#@TYPE: Machine
#@NAME: Radxa CM3 IO
#@DESCRIPTION: ROCK3 is the 3th generation of SBC and Computer Module designed by Radxa.
#https://wiki.radxa.com/Rock3/CM3/IO

require conf/machine/include/rk3568.inc

PREFERRED_PROVIDER_virtual/kernel = "linux-yocto-dev"
KERNEL_DEVICETREE = "rockchip/rk3568-rock-3a.dtb"
MACHINE_EXTRA_RRECOMMENDS += "kernel-modules"

UBOOT_MACHINE = "rock-3a-rk3568_defconfig"
```
